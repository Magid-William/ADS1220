## Kconfig
```kconfig
# Copyright (c) 2026 Magid-William
# SPDX-License-Identifier: MIT
#
# EXP02: ADS1220 TrackPoint bring-up logging helpers.
# See experiments/EXP02/README.md and boards/shields/ads1220_tpoint/.

config EXP02_LOGGING
	bool "ADS1220 TrackPoint EXP02 logging helpers (tpoint shell + raw callback)"
	default n
	depends on INPUT_ANALOG_AXIS_HIRES
	depends on SHELL
	depends on ADC
	help
	  Build exp02_logging.c: a `tpoint` shell command and a raw-data callback
	  that logs every ADS1220 sample for bench bring-up. Experimental; not for
	  a shipping configuration.

config EXP04_XY_LOG
	bool "EXP04: auto-enable paired raw X/Y logging at boot"
	default n
	depends on EXP02_LOGGING
	help
	  When set, exp02_logging.c enables the `tpoint xy` paired raw logger at
	  boot: one compact 'XY <ms> <x> <y>' line per poll. Test-time only
	  (EXP04 circle-motion capture); too noisy for a shipping configuration.
```

## boards/shields/ads1220_tpoint/Kconfig.defconfig
```kconfig
if SHIELD_ADS1220_TPOINT

config ZMK_KEYBOARD_NAME
    default "TP-ADS1220"

endif
```

## boards/shields/ads1220_tpoint/Kconfig.shield
```kconfig
config SHIELD_ADS1220_TPOINT
    def_bool $(shields_list_contains,ads1220_tpoint)
```
